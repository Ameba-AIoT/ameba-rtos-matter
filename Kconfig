## project/cmake/Kconfig
```kconfig
menu "Matter Config"
    config MATTER_EN
        bool "Enable Matter"
        default n
    if MATTER_EN
        choice
            prompt "Ameba RTOS version"
            default AMEBARTOS_V1_1
            config AMEBARTOS_V1_1
                bool "Ameba RTOS v1.1"
            config AMEBARTOS_V1_2
                bool "Ameba RTOS v1.2"
        endchoice
        config MBEDTLS_V_3_6_2_ENABLE
            bool
            default y
            depends on (AMEBADPLUS || AMEBALITE || AMEBASMART)
        config MBEDTLS_V_3_6_5_ENABLE
            bool
            default y
            depends on (AMEBAGREEN2)
        config BLE_MATTER_ADAPTER
            bool "BLE Matter Adapter"
            default n
            depends on BT_MENU
            if BLE_MATTER_ADAPTER
                config BLE_MATTER_MULTI_ADV_ON
                    bool "Enable BLE Matter Multi Adv"
                    default n
            endif
        config MATTER_ENABLE_IPV4
            bool "Enable Matter IPv4"
            default n
        config MATTER_ENABLE_TCP_ENDPOINT
            bool "Enable Matter TCP Endpoint"
            default n
        config MATTER_TC_EN
            bool "Enable Matter Terms and Condition"
            default n
        config MATTER_SECURE_EN
            bool "Enable Matter Secure"
            default n
            depends on ((AMEBADPLUS || AMEBALITE || AMEBAGREEN2) && (TRUSTZONE_FOR_KM4 || TRUSTZONE_EN)) || (AMEBASMART)
        config MATTER_SECURE
            bool
            default y
            depends on MATTER_SECURE_EN
        config COMPILE_MBEDTLS_FROM_MATTER_SECURE
            bool "Compile MbedTLS from Matter Secure (NOT NEEDED FOR LATEST V1.1 AND V1.2)"
            default n
            depends on MATTER_SECURE_EN
        config TZ_S_SIZE
            int
            default 136 if AMEBADPLUS
            default 120 if AMEBALITE
            depends on (AMEBARTOS_V1_1 && MATTER_SECURE_EN)
        config SECURE_HEAP_SIZE
            int
            default 14336
            depends on MATTER_SECURE_EN
    endif
endmenu
```
